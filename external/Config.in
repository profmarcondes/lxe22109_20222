## external/Config.in
```kconfig
# Place holder for load packages Config.in
menu "Labs Apps"
	source "$BR2_EXTERNAL_LXE22109_PATH/package/ninvaders/Config.in"
	source "$BR2_EXTERNAL_LXE22109_PATH/package/bar/Config.in"
endmenu
menu "Labs Libs"
	source "$BR2_EXTERNAL_LXE22109_PATH/package/libfoo/Config.in"
endmenu
```

## external/configs/webcam_defconfig
```kconfig
BR2_arm=y
BR2_cortex_a8=y
BR2_WGET="wget -nd -t 3"
BR2_GLOBAL_PATCH_DIR="$(BR2_EXTERNAL_LXE22109_PATH)/board/lxe22109/beaglebone/patches"
BR2_TOOLCHAIN_EXTERNAL=y
BR2_TOOLCHAIN_EXTERNAL_PREINSTALLED=y
BR2_TOOLCHAIN_EXTERNAL_PATH="/opt/buildroot/gcc-arm-10.3-2021.07-x86_64-arm-none-linux-gnueabihf/"
BR2_TARGET_GENERIC_ISSUE="Welcome to LXE22109"
BR2_TARGET_GENERIC_ROOT_PASSWD="tmp1223"
BR2_ROOTFS_OVERLAY="$(BR2_EXTERNAL_LXE22109_PATH)/board/lxe22109/beaglebone/rootfs_overlay"
BR2_ROOTFS_POST_BUILD_SCRIPT="$(BR2_EXTERNAL_LXE22109_PATH)/board/lxe22109/beaglebone/scripts/post-build.sh"
BR2_LINUX_KERNEL=y
BR2_LINUX_KERNEL_CUSTOM_VERSION=y
BR2_LINUX_KERNEL_CUSTOM_VERSION_VALUE="5.15.35"
BR2_LINUX_KERNEL_USE_CUSTOM_CONFIG=y
BR2_LINUX_KERNEL_CUSTOM_CONFIG_FILE="$(BR2_EXTERNAL_LXE22109_PATH)/board/lxe22109/beaglebone/linux.config"
BR2_LINUX_KERNEL_DTS_SUPPORT=y
BR2_LINUX_KERNEL_INTREE_DTS_NAME="am335x-boneblack"
BR2_LINUX_KERNEL_NEEDS_HOST_OPENSSL=y
BR2_PACKAGE_BUSYBOX_SHOW_OTHERS=y
BR2_PACKAGE_FFMPEG=y
BR2_PACKAGE_FFMPEG_SWSCALE=y
BR2_PACKAGE_GSTREAMER1=y
BR2_PACKAGE_GST1_PLUGINS_GOOD=y
BR2_PACKAGE_GST1_PLUGINS_UGLY=y
BR2_PACKAGE_V4L2GRAB=y
BR2_PACKAGE_VLC=y
BR2_PACKAGE_FSWEBCAM=y
BR2_PACKAGE_SDL2=y
BR2_PACKAGE_EVTEST=y
BR2_PACKAGE_LIBCONFIG=y
BR2_PACKAGE_LIBV4L_UTILS=y
BR2_PACKAGE_DHCP=y
BR2_PACKAGE_DHCP_SERVER=y
BR2_PACKAGE_DROPBEAR=y
BR2_PACKAGE_DROPBEAR_LASTLOG=y
BR2_PACKAGE_DROPBEAR_LEGACY_CRYPTO=y
BR2_PACKAGE_KMOD=y
BR2_PACKAGE_UTIL_LINUX=y
BR2_PACKAGE_UTIL_LINUX_LIBBLKID=y
BR2_TARGET_UBOOT=y
BR2_TARGET_UBOOT_BUILD_SYSTEM_KCONFIG=y
BR2_TARGET_UBOOT_CUSTOM_VERSION=y
BR2_TARGET_UBOOT_CUSTOM_VERSION_VALUE="2022.04"
BR2_TARGET_UBOOT_BOARD_DEFCONFIG="am335x_evm"
BR2_TARGET_UBOOT_NEEDS_OPENSSL=y
# BR2_TARGET_UBOOT_FORMAT_BIN is not set
BR2_TARGET_UBOOT_FORMAT_IMG=y
BR2_TARGET_UBOOT_SPL=y
BR2_TARGET_UBOOT_SPL_NAME="MLO"
BR2_TARGET_UBOOT_CUSTOM_MAKEOPTS="DEVICE_TREE=am335x-boneblack"
BR2_PACKAGE_HOST_ENVIRONMENT_SETUP=y
BR2_PACKAGE_NINVADERS=y
BR2_PACKAGE_BAR=y
BR2_PACKAGE_LIBFOO_DEBUG=y
```

## external/package/bar/Config.in
```kconfig
config BR2_PACKAGE_BAR
        bool "bar"
        select BR2_PACKAGE_LIBFOO
	help
		Bar application
		https://bootlin.com/~thomas/bar/
```

## external/package/libfoo/Config.in
```kconfig
config BR2_PACKAGE_LIBFOO
        bool "libfoo"
        help
		Libfoo: useless library for useless apps! ;)
		https://github.com/tpetazzoni/libfoo/

if BR2_PACKAGE_LIBFOO
config BR2_PACKAGE_LIBFOO_DEBUG
        bool "Enable debug print"
        help
           Enable debug flag on libfoo

endif
```

## lab-data/lab05/bar/Config.in
```kconfig
config BR2_PACKAGE_BAR
	bool "bar"
	select BR2_PACKAGE_LIBFOO
	help
	  Bar useless application

	  https://bootlin.com/~thomas/bar/
```
